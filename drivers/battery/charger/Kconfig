## drivers/sensorhub/factory/Light/Kconfig
```kconfig
#
# sensor drivers configuration
#

config SENSORS_SSP_LIGHT_TMD3725
	tristate "Sensors ssp light tmd3725"
	default n
	help
	  light tmd3725 file for factory test in ssp driver.
          If you say yes here you get light tmd3725 support for
	  factory test.
	  To compile this driver as a module, choose M here: the
	  module will be called ssp.

config SENSORS_SSP_LIGHT_TMD3700
	tristate "Sensors ssp light tmd3700"
	default n
	help
	  light tmd3700 file for factory test in ssp driver.
          If you say yes here you get light tmd3700 support for
	  factory test.
	  To compile this driver as a module, choose M here: the
	  module will be called ssp.

config SENSORS_SSP_LIGHT_TCS3701
	tristate "Sensors ssp light tcs3701"
	default n
	help
	  light tcs3701 file for factory test in ssp driver.
          If you say yes here you get light tcs3701 support for
	  factory test.
	  To compile this driver as a module, choose M here: the
	  module will be called ssp.

config SENSORS_SSP_LIGHT_VEML3328
	tristate "Sensors ssp light veml3328"
	default n
	help
	  light veml3328 file for factory test in ssp driver.
          If you say yes here you get light veml3328 support for
	  factory test.
	  To compile this driver as a module, choose M here: the
	  module will be called ssp.

config SENSORS_SSP_LIGHT_CM32183
	tristate "Sensors ssp light cm32183"
	default n
	help
	  light cm32183 file for factory test in ssp driver.
          If you say yes here you get light cm32183 support for
	  factory test.
	  To compile this driver as a module, choose M here: the
	  module will be called ssp.

config SENSORS_SSP_LIGHT_STK3X6X
	tristate "Sensors ssp light stk3x6x"
	default n
	help
	  light stk3x6x file for factory test in ssp driver.
          If you say yes here you get light stk3x6x support for
	  factory test.
	  To compile this driver as a module, choose M here: the
	  module will be called ssp.

config SENSORS_SSP_CAMERALIGHT_FOR_TAB
        tristate "Sensors ssp camera light for tab"
        default n
        help
          If you say yes here you get camera light support for tablet project.
          To compile this driver as a module, choose M here: the
          module will be called ssp.
```

## drivers/usb/typec/s2mu106/Kconfig
```kconfig
#
# S2MU106 driver
#

comment "S2MU106 configs"

config CCIC_S2MU106
	bool "Using S2MU106 USB PD"
	depends on USE_CCIC
	default n
	help
	  If you say yes here you will get support for
	  the S2MU106 USBPD chip.

config PDIC_PD30
	bool "support PD3.0"
	depends on CCIC_S2MU106
	default n
	help
	  If you say yes here you will get support for PD3.0

config CCIC_AUTO_PPS
    bool "support auto pps"
    depends on I2C
    default n
    help
      If you say yes here you will get support for
      sending pps message automatically
```

## drivers/vibrator/Kconfig
```kconfig
source "drivers/vibrator/common/Kconfig"

source "drivers/vibrator/dc/Kconfig"

source "drivers/vibrator/imagis/Kconfig"

source "drivers/vibrator/slsi/s2mu106/Kconfig"
```

## drivers/vibrator/slsi/s2mu106/Kconfig
```kconfig
#
#
#
config VIBRATOR_S2MU106
	tristate "SEC S2MU106 Vibrator"
	default n
	help
	  If you say yes here you will get support for the
	  SEC S2MU106 Vibrator.

config VIBRATOR_S2MU106_VOLTAGE_3P3
	tristate "SEC S2MU106 Voltage setting"
	default n
	help
	  If you say yes here you will get support for the
	  SEC S2MU106 Vibrator Voltage setting.
```

## drivers/video/fbdev/exynos/dpu20/panels/Kconfig
```kconfig
config EXYNOS_DECON_LCD
	depends on EXYNOS_DPU20
	bool "Select LCD panel driver"

config EXYNOS_DECON_LCD_S6E3HA2K
	depends on EXYNOS_DECON_LCD && EXYNOS_MIPI_DSIM
	tristate "S6E3HA2K AMOLED WQHD LCD driver(1440 x 2560)"

config EXYNOS_DECON_LCD_S6E3HF4
	depends on EXYNOS_DECON_LCD && EXYNOS_MIPI_DSIM
	tristate "S6E3HF4 AMOLED WQHD LCD driver(1440 x 2560)"
	default n

config EXYNOS_DECON_LCD_S6E3HA6
	depends on EXYNOS_DECON_LCD && EXYNOS_MIPI_DSIM
	tristate "S6E3HA6 AMOLED WQHD+ LCD driver(1440 x 2960)"
	default n

config EXYNOS_DECON_LCD_S6E3HA8
	depends on EXYNOS_DECON_LCD && EXYNOS_MIPI_DSIM
	tristate "S6E3HA8 AMOLED WQHD+ LCD driver(1440 x 2960)"
	default n

config EXYNOS_DECON_LCD_S6E3AA2
	depends on EXYNOS_DECON_LCD && EXYNOS_MIPI_DSIM
	tristate "S6E3AA2 AMOLED HD LCD driver(720 x 1280)"
	default n

config EXYNOS_DECON_LCD_S6E3FA0
	depends on EXYNOS_DECON_LCD && EXYNOS_MIPI_DSIM
	tristate "S6E3FA0 AMOLED HD LCD driver(1080 x 1920)"
	default n

config EXYNOS_DECON_LCD_S6E3FA7
	depends on EXYNOS_DECON_LCD && EXYNOS_MIPI_DSIM
	tristate "S6E3FA7 AMOLED FHD LCD driver(1080 x 2220)"
	default n

config EXYNOS_DECON_LCD_EA8076
	depends on EXYNOS_DECON_LCD && EXYNOS_MIPI_DSIM
	tristate "EA8076 FHD+ LCD driver(1080 x 2340)"
	default n

config EXYNOS_DECON_LCD_EMUL_DISP
	depends on EXYNOS_DECON_LCD && EXYNOS_MIPI_DSIM
	tristate "Virtual LCD driver for emulator(800 x 1280)"

config DISPLAY_USE_INFO
	tristate "Support display use info logging"
	default n

config EXYNOS_DECON_MDNIE
	tristate "Support MDNIE"
	default n

config SUPPORT_POC_FLASH
	tristate "Support display poc flash"
	default n
	
config LCD_HMT
	bool "Suppot video emul & aid reverse to VR"
	default n

config SUPPORT_MASK_LAYER
	bool "Support mask layer"
	default y

config LOGGING_BIGDATA_BUG
	bool "Logging extra information when decon bug"
	depends on SEC_DEBUG
	default n

config EXYNOS_DECON_LCD_S6E3FA9_A51
	tristate "S6E3FA9_A51 LCD driver"

config EXYNOS_DECON_LCD_NT36672A_XCOVERPRO
	tristate "NT36672A_XCOVERPRO LCD driver"

config EXYNOS_DECON_LCD_HX83102E_GTA4XL
	tristate "HX83102E_GTA4XL LCD driver"

config EXYNOS_DECON_LCD_EA8076_M31
	tristate "EA8076_M31 LCD driver"

config EXYNOS_DECON_LCD_EA8076_M31S
	tristate "EA8076_M31S LCD driver"
```
