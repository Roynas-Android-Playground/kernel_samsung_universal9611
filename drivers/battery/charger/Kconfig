## drivers/battery/charger/Kconfig
```kconfig
config CHARGER_DUMMY
	tristate "dummy charger driver"
	default n
	depends on BATTERY_SAMSUNG
	help
	 Say Y to include support
	 for dummy charger driver.
	 This driver source code implemented
	 skeleton source code for charger functions.

config CHARGER_PCA9468
	tristate "PCA9468 charger driver"
	default n
	depends on DIRECT_CHARGING
	help
	  Say Y here to enable support for the PCA9468 charger.
	  PCA9468 is direct charging IC by NXP.
	  PCA9468 depends on DIRECT_CHARGING
	  so it needs to be defined.

config CHARGER_S2MU106
    tristate "S2MU106 charger support"
    depends on (MFD_S2MU106) && I2C
    help
	  Say Y here to enable support for the S2MU106 charger.
	  S2MU106 charger is an AFC compatible charging IC.
	  S2MU106 charger is dependent on MFD_S2MU106
	  so it needs to be defined.

config CHARGER_SM5440
	tristate "SM5440 direct charger support"
	depends on I2C
	help
	  Say Y here to enable support for the SM5440 direct charger.
	  SM5440 is a direct charging IC.
	  SM5440 is dependent on I2C
	  so it needs to be defined.

config PM_S2MU106
	tristate "S2MU106 power meter support"
	depends on (MFD_S2MU106) && I2C
	help
	 Say Y here to enable support for the S2MU106 power meter.
	 S2MU106 power meter is dependent on I2C
	 so it needs to be defined.
```

## drivers/battery/fuelgauge/Kconfig
```kconfig
config FUELGAUGE_DUMMY
	tristate "dummy fuel gauge driver"
	default n
	depends on BATTERY_SAMSUNG
	help
	 Say Y to include support
	 for dummy fuel gauge driver.
	 This driver source code implemented
	 skeleton source code for fuel gauge functions.

config FUELGAUGE_S2MU106
	tristate "S2MU106 fuel gauge driver"
	default n
	depends on I2C
	help
	 Say Y to include support
	 for S.LSI S2MU106 fuel gauge driver.
	 Ths fuel-gauge supports current tracking and
	 voltage tracking to model the battery SOC.
```

## drivers/input/misc/hall/Kconfig
```kconfig
config HALL
    tristate "Enable HALL IC"
    default n
    help
      Say Y here if you want to enable Hall IC Feature
      and send a event when cover state is changed.
      Active gpio state is low and active event value is 0.

      If unsure, say N.

config CERTIFY_HALL
    tristate "Enable CERTIFY HALL IC"
    default n
    help
      Say Y here if you want to enable Certify Hall IC Feature and
      send a event when cover is detected.
      Active gpio state is low and active event value is 1.

      If unsure, say N.

config EMULATE_HALL_IC
    tristate "Enable EMULATE HALL IC"
    default n
    help
      Say Y here if you want to enable Emulate Hall IC Feature and
      send a event when cover is detected.

      If unsure, say N.

config HALL_NEW_NODE
	bool "Chang the node location of HALL IC"
	default y
	depends on HALL
	depends on ANDROID_MAJOR_VERSION >= "r"
	help
	  Say Y here if you want to change the location of hall ic node.
	  it was decided with the framework to be changed from R OS
	  The previous versions of R OS are created before the change.
	  If unsure, say N.

config WACOM_HALL
    tristate "Enable WACOM HALL IC"
    default n
    help
      Say Y here if you want to enable Wacom Hall IC Feature and
      send a event when cover is detected.
      Active gpio state is low and active event value is 1.

      If unsure, say N.
```

## drivers/input/touchscreen/novatek/nt36672a/Kconfig
```kconfig
#
# Novatek NT36xxx touchscreen driver configuration
#
config TOUCHSCREEN_NOVATEK_NT36672A
	bool "Novatek NT36672A"
	depends on I2C
	help
	  Say Y here if you have a Novatek NT36672A touchscreen connected
	  to your system.

	  If unsure, say N.
```

## drivers/media/platform/exynos/fimc-is2/sensor/module_framework/companion/Kconfig
```kconfig
menuconfig CAMERA_COMPANION_CHIP_SELECT
	bool "Sensor companion select"
	depends on USE_DIRECT_IS_CONTROL
	help
		Say Y here to enable support for platform-specific V4L drivers.

config CAMERA_COMPANION_CHIP_GC607_OBJ
		bool "Use GC607 companion"
	depends on USE_DIRECT_IS_CONTROL
	depends on CAMERA_COMPANION_CHIP_SELECT
		default n
		help
			Use to build gc607 companion.
```

## drivers/muic/Kconfig
```kconfig
#
# MUIC devices
#

comment "MUIC configs"

config USE_MUIC
	bool "Using MUIC device driver"
	depends on I2C
	default n
	help
	  If you say yes here you will get support for
	  the MUIC device driver.

config USE_SAFEOUT
	bool "Using SAFEOUT device driver"
	depends on I2C
	default n
	help
	  If you say yes here you will get support for
	  the SAFEOUT device driver.

config MUIC_NOTIFIER
	bool "MUIC notifier support"
	depends on USE_MUIC
	default n
	help
	  If you say yes here you will get support for
	  the MUIC attached device status change notification.

config MUIC_MANAGER
	bool "MUIC Manager supports CCIC chip interface"
	depends on USE_MUIC
	default n
	help
	  If you say yes here you will get support manager for the CCIC chip.

config MUIC_CORE
	bool "Supports MUIC Core"
	depends on USE_MUIC
	default n
	help
	  If you say yes here you will get support for the MUIC Core functionalities

config MUIC_HV
	bool "MUIC_HV"
	depends on USE_MUIC
	default n
	help
	  If you say yes here you will get support for the AFC.

config MUIC_HV_12V
	bool "MUIC_HV_12V"
	depends on MUIC_HV
	default n
	help
	  If you say yes here you will get support for the AFC.

config HV_MUIC_VOLTAGE_CTRL
	bool "Using AFC Voltage control functionality"
	depends on MUIC_HV
	default n
	help
	  If you say yes here you will get support for
	  the AFC voltage control functionality.

config MUIC_SUPPORT_CCIC
	bool "MUIC supports CCIC chip interface"
	depends on USE_MUIC
	default n
	help
	  If you say yes here you will get support for the CCIC chip.

config MUIC_SUPPORT_POWERMETER
	bool "MUIC supports PM chip interface"
	depends on USE_MUIC
	default n
	help
	  If you say yes here you will get support for the Power Meter.

config MUIC_SYSFS
	bool "Using muic sysfs Features"
	depends on USE_MUIC
	default n
	help
	  If you say yes here you will get support for the muic sysfs.

config MUIC_SUPPORT_VBUS_BOOST
	bool "Using muic Features for vbus boost"
	depends on USE_MUIC && BATTERY_SAMSUNG_V2
	default n
	help
	  If you say yes here you will get support for the muic vbus boosting.

config MUIC_SKIP_INCOMPLETE_INSERT
	bool "Not Using muic Features for incomplete insert"
	depends on USE_MUIC
	default n
	help
	  If you say yes here you will get support for the muic incomplete insert.

config MUIC_S2MU106
	bool "Using S2MU106 MUIC"
	depends on USE_MUIC && MFD_S2MU106
	default n
	help
	  If you say yes here you will get support for the S2MU106 MUIC chip.

config HV_MUIC_S2MU106_AFC
	bool "Using S2MU106 MUIC AFC"
	depends on MUIC_HV && MUIC_S2MU106
	default n
	help
	  If you say yes here you will get support for the AFC.

config MUIC_S2MU106_RID
	bool "Using S2MU106 MUIC RID"
	depends on MUIC_S2MU106
	default n
	help
	  If you say yes here you will get support for the S2MU106 MUIC RID functions.

config S2MU106_TYPEC_WATER
	bool "Using S2MU106 Type-C Water Detection"
	depends on MUIC_S2MU106_RID
	default n
	help
	  If you say yes here you will get support for
	  the S2MU106 Type-C Water functions.

config CP_UART_SWITCH
	bool "Using CP UART PATH"
	depends on USE_MUIC
	default n
	help
		If you say yes here you will get support for
		for the cp uart path feature.

config NEW_FACTORY_JIGONB
	bool "Using JIGONB control"
	depends on USE_MUIC
	default n
	help
		If you say yes here you will get support for
		for the jigonb control.

config NEW_FACTORY_UART
	bool "Using factory uart control"
	depends on USE_MUIC
	default n
	help
		If you say yes here you will get support for
		for the factory uart control.

config MUIC_INCOMPATIBLE_VZW
	bool "Using Verizon incomatible type"
	depends on USE_MUIC
	default n
	help
		If you say yes here you will get support for
		for the Verizon incomatible type cable.

config MUIC_SM5713
	bool "SM5713 MUIC"
	depends on USE_MUIC
	default n
	help
	  If you say yes here you will get support for the SM5713 MUIC chip.

config MUIC_BCD_RESCAN
	bool "SM MUIC supports BC 1.2 retry"
	depends on USE_MUIC
	default n
	help
	  If you say yes here you will get support for the BC 1.2 retry in SM MUIC chip.

config MUIC_SM5713_BC1_2_CERTI
	bool "MUIC_SM5713_BC1_2_CERTI"
	depends on MUIC_SM5713 && MUIC_SUPPORT_CCIC
	default n
	help
	  If you say yes here you will get support for BC12 certification of SM5713 one chip.

config HICCUP_CHARGER
	bool "Using HICCUP charger"
	depends on USE_MUIC && !SEC_FACTORY
	default n
	help
	  If you say yes here you will get support for
	  for the hiccup charger feature.

config MUIC_HV_SUPPORT_POGO_DOCK
	bool "MUIC_HV_SUPPORT_POGO_DOCK"
	depends on USE_MUIC
	default n
	help
	  If you say yes here you will get support for the AFC pogo dock.

config MUIC_TEST_FUNC
	bool "MUIC supports several function's in TEST"
	depends on SEC_DEBUG && !SAMSUNG_PRODUCT_SHIP
	default n
	help
	  If you say yes here you will get support for the TEST function's.

config MUIC_SUPPORT_PRSWAP
	bool "MUIC supports power role swap"
	depends on USE_MUIC
	default n
	help
	  If you say yes here you will get support for the power role swap.
```

## drivers/sensorhub/Kconfig
```kconfig
#
# sensor hub drivers configuration
#

config SENSORS_SSP
	tristate "Sensors ssp"
	default n
	depends on SPI
	help
	  ssp driver for sensor hub.
          If you say yes here you get ssp support for
	  sensor hub.
	  To compile this driver as a module, choose M here: the
	  module will be called ssp.

config SSP_ENG_DEBUG
	tristate "sensor hub eng debug mode"
	default n	
	help	  
	  If you want to use eng debug mode for sensor hub, it should be set.

config SENSORS_SSP_A51
	tristate "Sensors ssp a51"
	default n
	help
	  If you want to use sensor hub for a51 project, it should be set.

config SENSORS_SSP_XCOVERPRO
	tristate "Sensors ssp xcoverpro"
	default n
	help
	  If you want to use sensor hub for xcoverpro project, it should be set.

config SENSORS_SSP_GTA4XL
	tristate "Sensors ssp g4a4xl"
	default n
	help
	  If you want to use sensor hub for g4a4xl project, it should be set.

config SENSORS_SSP_M31
	tristate "Sensors ssp m31"
	default n
	help
	  If you want to use sensor hub for m31 project, it should be set.

config SENSORS_SSP_M21
	tristate "Sensors ssp m21"
	default n
	help
	  If you want to use sensor hub for m21 project, it should be set.

config SENSORS_SSP_M31S
	tristate "Sensors ssp m31s"
	default n
	help
	  If you want to use sensor hub for m31s project, it should be set.

config SENSORS_SSP_GYROFILE_FOR_MAG
	tristate "use gyro cal file for mag cal"
	default n	
	help	  
	  If you want to use gyro cal file for magnetic sensor, it should be set.

config SENSORS_A96T3X6
	depends on I2C
	tristate "A96T3X6 touchkey"
	default n
	help
	  If you say yes here if you use A96T3X6 for grip.
	  This option enables grip sensors using
	  Above A96T3X6 device driver for grip.

config SENSORS_A96T3X6_SUB
	depends on I2C
	tristate "A96T3X6 driver for grip"
	default n
	help
	  Say Y here if you use A96T3X6 for grip.
	  This option enables grip sensors using
	  Above A96T3X6 device driver for grip.

config SENSORS_A96T3X6_WIFI
	depends on I2C
	tristate "A96T3X6 driver for grip"
	default n
	help
	  Say Y here if you use A96T3X6 for grip.
	  This option enables grip sensors using
	  Above A96T3X6 device driver for grip.

config SENSORS_A96T3X6_2CH
	depends on I2C
	tristate "SENSORS_A96T3X6_2CH driver for grip"
	default n
	help
	  Say Y here if you use SENSORS_A96T3X6_2CH for grip.
	  This option enables grip sensors using
	  Above SENSORS_A96T3X6_2CH device driver for grip.

config SENSORS_A96T3X6_WIFI_2CH
	depends on I2C
	tristate "SENSORS_A96T3X6_WIFI_2CH driver for grip"
	default n
	help
	  Say Y here if you use SENSORS_A96T3X6_WIFI_2CH for grip.
	  This option enables grip sensors using
	  Above SENSORS_A96T3X6_WIFI_2CH device driver for grip.

config SENSOR_A96T3X6_LDO_SHARE
	depends on I2C
	tristate "SENSOR_A96T3X6_LDO_SHARE driver for grip"
	default n
	help
	  Say Y here if you use SENSOR_A96T3X6_LDO_SHARE for grip.
	  This option enables grip sensors using
	  Above SENSOR_A96T3X6_LDO_SHARE device driver for grip.

config SENSORS_A96T3X6_CRC_CHECK
	bool "check crc check instead of checksum compare"
	default n
	help
	  Say Y here if you use crc check instead of checksum compare

config SENSORS_FW_VENDOR
	bool "Locate the Firmware on Vendor"
	default n
	help
	  To use the module automatic system, 
	  locate the firmware on vendor side.
	  DO NOT say Y when ABOV GRIP senseors use a common ldo.

config SENSORS_A96T3X6_TABA4XL
	depends on I2C
	tristate "A96T3X6 touchkey"
	default n
	help
	  If you say yes here if you use A96T3X6 for grip.
	  This option enables grip sensors using
	  Above A96T3X6 device driver for grip.

config SENSORS_A96T3X6_M30S
	depends on I2C
	tristate "A96T3X6 touchkey"
	default n
	help
	  If you say yes here if you use A96T3X6 for grip.
	  This option enables grip sensors using
	  Above A96T3X6 device driver for grip.

config SENSORS_A96T3X6_M31
	depends on I2C
	tristate "A96T3X6 touchkey"
	default n
	help
	  If you say yes here if you use A96T3X6 for grip.
	  This option enables grip sensors using
	  Above A96T3X6 device driver for grip.

config SENSORS_A96T3X6_A51
	depends on I2C
	tristate "A96T3X6 touchkey"
	default n
	help
	  If you say yes here if you use A96T3X6 for grip.
	  This option enables grip sensors using
	  Above A96T3X6 device driver for grip.

config SENSORS_A96T3X6_A51_USA
	depends on I2C
	tristate "A96T3X6 touchkey"
	default n
	help
	  If you say yes here if you use A96T3X6 for grip.
	  This option enables grip sensors using
	  Above A96T3X6 device driver for grip.

config SENSORS_TC3XXK
	depends on I2C
	tristate "TC3XXK driver for grip Sensor"
	default n
	help
	  Say Y here if you use TC3XXK IC for grip Sensor.
	  This option enables grip sensors using
	  Coreriver TC305K device driver for grip Sensor.

config SENSORS_SX9360
	depends on I2C
	tristate "SX9360 driver"
	default n
	help
	  Say Y here if you use sx9360.
	  This option enables grip sensors using
	  SemTech sx9360 device driver.
	  Say N here if you do not use sx9360.

config SENSORS_SX9360_SUB
	depends on I2C
	tristate "SX9330 sub driver"
	default n
	help
	  Say Y here if you use sx9330 sub.
	  This option enables grip sensors using
	  SemTech sx9330 sub device driver.
	  Say N here if you do not use sx9330 sub.

config SENSORS_ISG5320A
	depends on I2C
	tristate "ISG5320A grip"
	default n
	help
	  If you say yes here if you use ISG5320A for grip.
	  This option enables grip sensors using
	  IMAGIS ISG5320A device driver for grip.

config SENSORS_ISG5320A_SUB
	depends on I2C
	tristate "ISG5320A grip sub"
	default n
	help
	  If you say yes here if you use ISG5320A_SUB for grip sub.
	  This option enables grip sensors using
	  IMAGIS ISG5320A_SUB device driver for grip sub.
	  
source "drivers/sensorhub/factory/Kconfig"
```
